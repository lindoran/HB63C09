; MON09 ROM ENTRY POINTS FOR USER PROGRAMS
MON09_CHKCHR	EQU	$E44C
MON09_DISASS	EQU	$E46D
MON09_DISREG	EQU	$E476
MON09_DLOAD	EQU	$E467
MON09_FIRQADR	EQU	$FD59
MON09_GETADR	EQU	$E446
MON09_GETBYT	EQU	$E443
MON09_GETCHR	EQU	$E43A
MON09_GETECH	EQU	$E43D
MON09_GETNIB	EQU	$E440
MON09_GETRNG	EQU	$E449
MON09_HEXOUT	EQU	$E45B
MON09_HOUT	EQU	$E458
MON09_ILOPADR	EQU	$FD61
MON09_IRQADR	EQU	$FD5D
MON09_LFCR	EQU	$E455
MON09_LOAD	EQU	$E46A
MON09_MONITOR	EQU	$E479
MON09_PUTCHR	EQU	$E44F
MON09_RESET	EQU	$E47C
MON09_SPACE	EQU	$E452
MON09_STEPDI	EQU	$E473
MON09_STEP	EQU	$E470
MON09_SWI2ADR	EQU	$FD51
MON09_SWI3ADR	EQU	$FD55
MON09_SWIADR	EQU	$FD4D
MON09_WRDOUT	EQU	$E45E
MON09_WRLIN	EQU	$E461
MON09_WRMSG	EQU	$E464
