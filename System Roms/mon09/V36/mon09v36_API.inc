; MON09 ROM ENTRY POINTS FOR USER PROGRAMS
MON09_CHKCHR	EQU	$E415
MON09_DISASS	EQU	$E436
MON09_DISREG	EQU	$E43F
MON09_DLOAD	EQU	$E430
MON09_FIRQADR	EQU	$FDAC
MON09_GETADR	EQU	$E40F
MON09_GETBYT	EQU	$E40C
MON09_GETCHR	EQU	$E403
MON09_GETECH	EQU	$E406
MON09_GETNIB	EQU	$E409
MON09_GETRNG	EQU	$E412
MON09_HEXOUT	EQU	$E424
MON09_HOUT	EQU	$E421
MON09_ILOPADR	EQU	$FDB8
MON09_IRQADR	EQU	$FDB0
MON09_LFCR	EQU	$E41E
MON09_LOAD	EQU	$E433
MON09_MONITOR	EQU	$E442
MON09_NMIADR	EQU	$FDB4
MON09_PUTCHR	EQU	$E418
MON09_RESET	EQU	$E445
MON09_SPACE	EQU	$E41B
MON09_STEPDI	EQU	$E43C
MON09_STEP	EQU	$E439
MON09_SWI2ADR	EQU	$FDA4
MON09_SWI3ADR	EQU	$FDA8
MON09_SWIADR	EQU	$FDA0
MON09_WRDOUT	EQU	$E427
MON09_WRLIN	EQU	$E42A
MON09_WRMSG	EQU	$E42D
